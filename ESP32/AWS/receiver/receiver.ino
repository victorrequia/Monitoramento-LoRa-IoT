#include "secrets.h"
#include "LoRaWan_APP.h"
#include "Arduino.h"
#include <ArduinoJson.h>
#include <WiFiClientSecure.h>
#include <WiFi.h>
#include <PubSubClient.h>

#define RF_FREQUENCY                                915000000
#define TX_OUTPUT_POWER                             14
#define LORA_BANDWIDTH                              0
#define LORA_SPREADING_FACTOR                       7
#define LORA_CODINGRATE                             1
#define LORA_PREAMBLE_LENGTH                        8
#define LORA_SYMBOL_TIMEOUT                         0
#define LORA_FIX_LENGTH_PAYLOAD_ON                  false
#define LORA_IQ_INVERSION_ON                        false
#define RX_TIMEOUT_VALUE                            1000
#define BUFFER_SIZE                                 30

// Display
#include "string.h"
#include "stdio.h"
#include "HT_SSD1306Wire.h"


const char *SSID = "TP-Link_49CF";
const char *PWD = "Apartamento208";


#define AWS_IOT_PUBLISH_TOPIC "sdk/test/java"
char *mqttServer = "a3rbx8m2z4xd0g-ats.iot.sa-east-1.amazonaws.com";
int mqttPort = 8883;

WiFiClientSecure net = WiFiClientSecure();
PubSubClient mqttClient(net);


char txpacket[BUFFER_SIZE];
char rxpacket[BUFFER_SIZE];

static RadioEvents_t RadioEvents;

int16_t txNumber;

int16_t rssi,rxSize;

bool lora_idle = true;

// Display
extern SSD1306Wire display;
#define logo_width 128
#define logo_height 53

const unsigned char logo_bits[] = {
  0x00, 0x00, 0x38, 0x00, 0x00, 0x00, 0x00, 0x00, 0x00, 0x00, 0x00, 0x00, 
  0x00, 0x00, 0x00, 0x00, 0x70, 0x00, 0xF8, 0x00, 0x00, 0x00, 0x00, 0x00, 
  0x00, 0x00, 0x00, 0x00, 0x00, 0x00, 0x00, 0x00, 0xE0, 0x01, 0xF0, 0x03, 
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  0x00, 0x00, 0x00, 0x00, 0x00, 0x00, 0x00, 0x00,};

//Wifi
void connectToWiFi() {
  Serial.print("Connecting to ");
 
  WiFi.begin(SSID, PWD);
  Serial.println(SSID);
  while (WiFi.status() != WL_CONNECTED) {
    Serial.print(".");
    delay(1000);
  }
  Serial.println(" Connected.");
  Serial.print("IP address: ");
  Serial.print(WiFi.localIP());
  Serial.print("\n");
}

void setupMQTT() {
  net.setCACert(AWS_CERT_CA);
  net.setCertificate(AWS_CERT_CRT);
  net.setPrivateKey(AWS_CERT_PRIVATE);

  mqttClient.setServer(mqttServer, mqttPort);
  mqttClient.setClient(net);
  mqttClient.setServer(mqttServer, mqttPort);
}

void reconnect() {
    while (!mqttClient.connected()) {
        Serial.print("Attempting MQTT connection...");
        // Tente conectar
        if (mqttClient.connect("ESP32_DHT11")) {
            Serial.println("connected");
            // Se inscreva ou publique aqui
        } else {
            Serial.print("failed, rc=");
            Serial.print(mqttClient.state());
            Serial.println(" try again in 5 seconds");
            // Espere 5 segundos antes de tentar novamente
            delay(5000);
        }
    }
}


// Dipay Data
void LoRaData() {
  display.clear();
  display.setTextAlignment(TEXT_ALIGN_LEFT);
  display.setFont(ArialMT_Plain_10);

  // Exibe o IP do Broker
  display.drawString(0, 0, "Broker IP: " + String(mqttServer));

  // Exibe o tamanho da mensagem recebida
  display.drawString(0 , 11 , "Recebido " + String(rxSize) + " bytes");

  float temp;
  float humidity;
  int uv;
  sscanf(rxpacket, "%f,%f,%d", &temp, &humidity, &uv);

  // Exibe o valor da temperatura
  display.drawString(0, 26, "Temperatura: " + String(temp, 2) + " °C");

  // Exibe o valor da umidade
  display.drawString(0, 37, "Umidade: " + String(humidity, 2) + "%");

  // Exibe o valor da radiação UV
  display.drawString(0, 48, "UV: " + String(uv));

  display.display();
}

void setup() {
    Serial.begin(115200);

    // Wifi and MQTT
    connectToWiFi();
    setupMQTT();

    // Display
    display.init();
    display.flipScreenVertically();  
    display.setFont(ArialMT_Plain_10);
  
    Mcu.begin();
    
    txNumber=0;
    rssi=0;
  
    RadioEvents.RxDone = OnRxDone;
    Radio.Init( &RadioEvents );
    Radio.SetChannel( RF_FREQUENCY );
    Radio.SetRxConfig( MODEM_LORA, LORA_BANDWIDTH, LORA_SPREADING_FACTOR, LORA_CODINGRATE, 0, LORA_PREAMBLE_LENGTH, LORA_SYMBOL_TIMEOUT, LORA_FIX_LENGTH_PAYLOAD_ON, 0, true, 0, 0, LORA_IQ_INVERSION_ON, true );
}


void loop(){
  if (!mqttClient.connected())
    reconnect();
  mqttClient.loop();
  
  if(lora_idle)
  {
    lora_idle = false;
    Serial.println("into RX mode");
    Radio.Rx(0);
    LoRaData();
  }
  Radio.IrqProcess( );
}

void OnRxDone(uint8_t *payload, uint16_t size, int16_t rssi, int8_t snr) {
    rssi = rssi;
    rxSize = size;
    memcpy(rxpacket, payload, size);
    rxpacket[size] = '\0';

    float temp;
    float humidity;
    int uvValue;
    sscanf(rxpacket, "%f,%f,%d", &temp, &humidity, &uvValue);

    char tempStr[8];
    sprintf(tempStr, "%.2f", temp); // Formata a temperatura com duas casas decimais

    // Cria um objeto JSON
    StaticJsonDocument<200> doc;
    doc["temperature"] = tempStr; // Usa a string formatada
    doc["humidity"] = humidity;
    doc["uv"] = uvValue;

    // Serializa o JSON para uma string
    char jsonOutput[128];
    serializeJson(doc, jsonOutput);

    // Publica o JSON no tópico MQTT
    mqttClient.publish(AWS_IOT_PUBLISH_TOPIC, jsonOutput);

    Radio.Sleep();
    Serial.printf("\r\nreceived packet \"%s\" with rssi %d, length %d\r\n", rxpacket, rssi, rxSize);
    lora_idle = true;
}
