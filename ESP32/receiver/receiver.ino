#include "LoRaWan_APP.h"
#include "Arduino.h"
#include <WiFi.h>
#include <PubSubClient.h>

const char *SSID = "TP-Link_49CF";
const char *PWD = "Apartamento208";

char *mqttServer = "192.168.0.129";
int mqttPort = 1883;

WiFiClient wifiClient;
PubSubClient mqttClient(wifiClient);


#define RF_FREQUENCY                                915000000 // Hz

#define TX_OUTPUT_POWER                             14        // dBm

#define LORA_BANDWIDTH                              0         // [0: 125 kHz,
                                                              //  1: 250 kHz,
                                                              //  2: 500 kHz,
                                                              //  3: Reserved]
#define LORA_SPREADING_FACTOR                       7         // [SF7..SF12]
#define LORA_CODINGRATE                             1         // [1: 4/5,
                                                              //  2: 4/6,
                                                              //  3: 4/7,
                                                              //  4: 4/8]
#define LORA_PREAMBLE_LENGTH                        8         // Same for Tx and Rx
#define LORA_SYMBOL_TIMEOUT                         0         // Symbols
#define LORA_FIX_LENGTH_PAYLOAD_ON                  false
#define LORA_IQ_INVERSION_ON                        false


#define RX_TIMEOUT_VALUE                            1000
#define BUFFER_SIZE                                 30 // Define the payload size here

// Display
#include "string.h"
#include "stdio.h"
#include "HT_SSD1306Wire.h"

char txpacket[BUFFER_SIZE];
char rxpacket[BUFFER_SIZE];

static RadioEvents_t RadioEvents;

int16_t txNumber;

int16_t rssi,rxSize;

bool lora_idle = true;

// Display
extern SSD1306Wire display;
#define logo_width 128
#define logo_height 53

const unsigned char logo_bits[] = {
   0x00, 0x00, 0x38, 0x00, 0x00, 0x00, 0x00, 0x00, 0x00, 0x00, 0x00, 0x00, 
  0x00, 0x00, 0x00, 0x00, 0x70, 0x00, 0xF8, 0x00, 0x00, 0x00, 0x00, 0x00, 
  0x00, 0x00, 0x00, 0x00, 0x00, 0x00, 0x00, 0x00, 0xE0, 0x01, 0xF0, 0x03, 
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  0x00, 0x00, 0x00, 0x00, 0x00, 0x00, 0x00, 0x00,};

//Wifi
void connectToWiFi() {
  Serial.print("Connecting to ");
 
  WiFi.begin(SSID, PWD);
  Serial.println(SSID);
  while (WiFi.status() != WL_CONNECTED) {
    Serial.print(".");
    delay(1000);
  }
  Serial.println(" Connected.");
  Serial.print("IP address: ");
  Serial.print(WiFi.localIP());
  Serial.print("\n");
}

void setupMQTT() {
  mqttClient.setServer(mqttServer, mqttPort);
}

void reconnect() {
  Serial.println("Connecting to MQTT Broker...");
  while (!mqttClient.connected()) {
      Serial.println("Reconnecting to MQTT Broker..");
      String clientId = "CLIENT ESP32 - ";
      clientId += String(random(0xffff), HEX);
      
      if (mqttClient.connect(clientId.c_str())) {
        Serial.println("Connected.");
      }
  }
  delay(3000);
}

// Dipay Data
void LoRaData() {
  display.clear();
  display.setTextAlignment(TEXT_ALIGN_LEFT);
  display.setFont(ArialMT_Plain_10);

  // Exibe o IP do Broker
  display.drawString(0, 0, "Broker IP: " + String(mqttServer));

  // Exibe o tamanho da mensagem recebida
  display.drawString(0 , 11 , "Recebido " + String(rxSize) + " bytes");

  float temp;
  float humidity;
  int uv;
  sscanf(rxpacket, "%f,%f,%d", &temp, &humidity, &uv);

  // Exibe o valor da temperatura
  display.drawString(0, 26, "Temperatura: " + String(temp, 2) + " °C");

  // Exibe o valor da umidade
  display.drawString(0, 37, "Umidade: " + String(humidity, 2) + "%");

  // Exibe o valor da radiação UV
  display.drawString(0, 48, "UV: " + String(uv));

  display.display();
}

void setup() {
    Serial.begin(115200);

    // Wifi and MQTT
    connectToWiFi();
    setupMQTT();

    // Display
    display.init();
    display.flipScreenVertically();  
    display.setFont(ArialMT_Plain_10);
  
    Mcu.begin();
    
    txNumber=0;
    rssi=0;
  
    RadioEvents.RxDone = OnRxDone;
    Radio.Init( &RadioEvents );
    Radio.SetChannel( RF_FREQUENCY );
    Radio.SetRxConfig( MODEM_LORA, LORA_BANDWIDTH, LORA_SPREADING_FACTOR, LORA_CODINGRATE, 0, LORA_PREAMBLE_LENGTH, LORA_SYMBOL_TIMEOUT, LORA_FIX_LENGTH_PAYLOAD_ON, 0, true, 0, 0, LORA_IQ_INVERSION_ON, true );
}


void loop(){
  if (!mqttClient.connected())
    reconnect();
  mqttClient.loop();
  
  if(lora_idle)
  {
    lora_idle = false;
    Serial.println("into RX mode");
    Radio.Rx(0);
    LoRaData();
  }
  Radio.IrqProcess( );
}

void OnRxDone( uint8_t *payload, uint16_t size, int16_t rssi, int8_t snr )
{
    rssi=rssi;
    rxSize=size;
    memcpy(rxpacket, payload, size );
    rxpacket[size]='\0';

    float temp;
    float humidity;
    int uvValue;
    sscanf(rxpacket, "%f,%f,%d", &temp, &humidity, &uvValue);

    char tempChar[30];
    snprintf(tempChar, sizeof(tempChar), "%0.2f", temp);
    mqttClient.publish("/temperatura", tempChar);    

    char humidityChar[30];
    snprintf(humidityChar, sizeof(humidityChar), "%0.2f%", humidity);
    mqttClient.publish("/umidade", humidityChar);

    char uvChar[30];
    snprintf(uvChar, sizeof(uvChar), "%d", uvValue);
    mqttClient.publish("/uv", uvChar);
    
    Radio.Sleep( );
    Serial.printf("\r\nreceived packet \"%s\" with rssi %d , length %d\r\n",rxpacket,rssi,rxSize);
    lora_idle = true;
}
